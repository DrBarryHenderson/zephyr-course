## app/boards/my_board/board.yml
```yaml
board:
  name: my_board
  full_name: My Board from Scratch
  vendor: iomoco
  socs:
  # Physical nRF52840 SoC on PCA10056
  - name: nrf52840
```

## app/boards/our_board/board.yml
```yaml
board:
  name: our_board
  full_name: Our Board
  vendor: iomoco
  socs:
  # Physical nRF52840 SoC on PCA10056
  - name: nrf52840
```
